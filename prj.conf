## CMakeLists.txt
```
cmake_minimum_required(VERSION 3.20.0)

set(BOARD arduino_nano_33_ble)

find_package(Zephyr REQUIRED HINTS $ENV{ZEPHYR_BASE})
project(megabit-coproc)

target_sources(app
  PRIVATE
    src/cobs/cobs-decoder.cpp
    src/led.cpp
    src/main.cpp
    src/usb.cpp
)
target_include_directories(app
  PRIVATE
    src
    third-party
)
```

## Kconfig
```
source "Kconfig.usb_serial"
source "Kconfig.zephyr"
```

## Kconfig.usb_serial
```
menu "USB sample options"
    depends on USB_DEVICE_STACK_NEXT

config USB_SERIAL_MANUFACTURER
    string "USB device manufacturer string"
    default "Snostorm Labs"
    help
        USB device manufacturer string.

config USB_SERIAL_PRODUCT
    string "USB device product string"
    default "Megabit coproc"
    help
        USB device product string.

config USB_SERIAL_PID
    hex "USB device product ID"
    default 0x1337
    help
        USB device product ID.

endmenu
```

## west.yml
```
manifest:
  remotes:
    - name: zephyrproject-rtos
      url-base: https://github.com/zephyrproject-rtos

  projects:
    - name: zephyr
      remote: zephyrproject-rtos
      revision: main
      import:
        name-allowlist:
          - cmsis
          - hal_nordic
```

## prj.conf
```kconfig
CONFIG_CPP=y
CONFIG_GLIBCXX_LIBCPP=y
CONFIG_GPIO=y
CONFIG_STD_CPP20=y

CONFIG_PWM=y
CONFIG_EVENTS=y

CONFIG_USB_DEVICE_STACK_NEXT=y
CONFIG_USB_DEVICE_PRODUCT="Megabit coproc"
CONFIG_USB_DEVICE_PID=0x1337
CONFIG_LOG=y
CONFIG_USB_DRIVER_LOG_LEVEL_ERR=y
CONFIG_USB_DEVICE_LOG_LEVEL_ERR=y
CONFIG_SERIAL=y
CONFIG_UART_INTERRUPT_DRIVEN=y
CONFIG_UART_LINE_CTRL=y
CONFIG_USBD_CDC_ACM_CLASS=y

CONFIG_STDOUT_CONSOLE=y
#CONFIG_SEMIHOST=y
#CONFIG_SEMIHOST_CONSOLE=y
```

## src/main.cpp
```c
#include "led.hpp"
#include "usb.hpp"
#include <cstdio>
#include <cstdint>
#include <cstring>
#include <zephyr/kernel.h>
#include <zephyr/logging/log.h>

LOG_MODULE_REGISTER(megabit, LOG_LEVEL_INF);

int main() {
    if (int ret = led::init_leds(); ret != 0) {
        LOG_ERR("Failed to init LEDs: %d", ret);
        return 0;
    }

    bool led_state = true;
    u32 counter = 1;
    while (true) {
        led_state = !led_state;
        led::set_state(led_state);
        led::set_color(static_cast<led::Color>(counter & 0b11));
        ++counter;
        LOG_INF("LED state: %s", led_state ? "ON" : "OFF");
        k_msleep(1000);
    }

	return 0;
}
```

## src/led.cpp
```c
#include "led.hpp"

#include <zephyr/drivers/gpio.h>
#include <zephyr/drivers/pwm.h>
#include <zephyr/kernel.h>
#include <zephyr/logging/log.h>

LOG_MODULE_REGISTER(led, LOG_LEVEL_INF);

namespace led {
namespace {

// DL2 green LED
const struct gpio_dt_spec SIMPLE_LED = GPIO_DT_SPEC_GET(DT_ALIAS(led4), gpios);
// DL3 RGB LED
const struct pwm_dt_spec RED_PWM_LED = PWM_DT_SPEC_GET(DT_ALIAS(red_pwm_led));
const struct pwm_dt_spec GREEN_PWM_LED = PWM_DT_SPEC_GET(DT_ALIAS(green_pwm_led));
const struct pwm_dt_spec BLUE_PWM_LED = PWM_DT_SPEC_GET(DT_ALIAS(blue_pwm_led));
constexpr u32 PWM_STEP_SIZE_US = PWM_USEC(2000);
constexpr float MAX_BRIGHTNESS_DIM_RATIO(0.75);

} // namespace

int init_leds() {
    if (!gpio_is_ready_dt(&SIMPLE_LED) || !pwm_is_ready_dt(&RED_PWM_LED) || !pwm_is_ready_dt(&GREEN_PWM_LED) || !pwm_is_ready_dt(&BLUE_PWM_LED)) {
        return -ENODEV;
    }
    if (int ret = gpio_pin_configure_dt(&SIMPLE_LED, GPIO_OUTPUT_INACTIVE); ret < 0) {
        return ret;
    }
    if (int ret = pwm_set_pulse_dt(&RED_PWM_LED, 0); ret != 0) {
        return ret;
    }
    if (int ret = pwm_set_pulse_dt(&GREEN_PWM_LED, 0); ret != 0) {
        return ret;
    }
    if (int ret = pwm_set_pulse_dt(&BLUE_PWM_LED, 0); ret != 0) {
        return ret;
    }

    return 0;
}

int toggle() {
    return gpio_pin_toggle_dt(&SIMPLE_LED);
}

int set_state(bool new_state) {
    return gpio_pin_configure_dt(&SIMPLE_LED, new_state ? GPIO_OUTPUT_ACTIVE : GPIO_OUTPUT_INACTIVE);
}

int set_color(Color color) {
    int retVal = 0;
    switch (color) {
        case Color::Red:
            retVal |= pwm_set_pulse_dt(&RED_PWM_LED, RED_PWM_LED.period * MAX_BRIGHTNESS_DIM_RATIO);
            retVal |= pwm_set_pulse_dt(&GREEN_PWM_LED, 0);
            retVal |= pwm_set_pulse_dt(&BLUE_PWM_LED, 0);
            break;
        case Color::Green:
            retVal |= pwm_set_pulse_dt(&GREEN_PWM_LED, GREEN_PWM_LED.period * MAX_BRIGHTNESS_DIM_RATIO);
            retVal |= pwm_set_pulse_dt(&RED_PWM_LED, 0);
            retVal |= pwm_set_pulse_dt(&BLUE_PWM_LED, 0);
            break;
        case Color::Blue:
            retVal |= pwm_set_pulse_dt(&BLUE_PWM_LED, BLUE_PWM_LED.period * MAX_BRIGHTNESS_DIM_RATIO);
            retVal |= pwm_set_pulse_dt(&RED_PWM_LED, 0);
            retVal |= pwm_set_pulse_dt(&GREEN_PWM_LED, 0);
            break;
        case Color::None:
        default:
            retVal |= pwm_set_pulse_dt(&RED_PWM_LED, 0);
            retVal |= pwm_set_pulse_dt(&GREEN_PWM_LED, 0);
            retVal |= pwm_set_pulse_dt(&BLUE_PWM_LED, 0);
            break;
    }
    return retVal;
}

void execute_panic_loop() {
    constexpr u32 PANIC_SHORT_HALF_PERIOD_MS(100);
    constexpr u32 PANIC_LONG_HALF_PERIOD_MS(700);
    while (true) {
        for (auto i = 0u; i < 3; ++i) {
            set_state(true);
            set_color(Color::Red);
            k_msleep(PANIC_LONG_HALF_PERIOD_MS);
            set_state(false);
            set_color(Color::None);
            k_msleep(PANIC_LONG_HALF_PERIOD_MS);
        }
        for (auto i = 0u; i < 3; ++i) {
            set_state(true);
            set_color(Color::Red);
            k_msleep(PANIC_SHORT_HALF_PERIOD_MS);
            set_state(false);
            set_color(Color::None);
            k_msleep(PANIC_SHORT_HALF_PERIOD_MS);
        }
    }
}


} // namespace led
```

## src/led.hpp
```c
#pragma once

#include "types.hpp"

namespace led {

enum Color : u8 {
    None = 0u,
    Red = 1u,
    Green = 2u,
    Blue = 3u,
};

int init_leds();

int toggle();

int set_state(bool new_state);

int set_color(Color color);

void execute_panic_loop();

} // namespace led
```

## src/ring-buffer.hpp
```c
#pragma once

#include "types.hpp"
#include <zephyr/sys/ring_buffer.h>
#include <array>
#include <cstdint>

template <usize N>
class RingBuffer {
private:
    std::array<uint8_t, N> inner_buffer;
    struct ring_buf inner;

public:

    explicit RingBuffer() 
        : inner_buffer(),
          inner()
    {
        ring_buf_init(&inner, inner_buffer.size(), inner_buffer.data());
    }
    ~RingBuffer() = default;

    usize read(uint8_t * const output_buffer, usize buffer_len) {
        return ring_buf_get(&inner, output_buffer, buffer_len);
    }

    usize write(uint8_t * const input_buffer, usize bytes_to_write) {
        return ring_buf_put(&inner, input_buffer, bytes_to_write);
    }

    usize space_in_buffer() {
        return ring_buf_space_get(&inner);
    }

    bool empty() {
        return ring_buf_space_get(&inner) == N;
    }
};
```

## src/types.hpp
```c
#pragma once

#include <cstddef>
#include <cstdint>

using u8 = uint8_t;
using i8 = int8_t;
using u16 = uint16_t;
using i16 = int16_t;
using u32 = uint32_t;
using i32 = int32_t;
using usize = size_t;
using isize = std::ptrdiff_t;
using f32 = float;
using f64 = double;
```

## src/usb.cpp
```c
#include "ring-buffer.hpp"
#include "usb.hpp"
#include <algorithm>
#include <array>
#include <cstdint>
#include <optional>
#include <zephyr/device.h>
#include <zephyr/drivers/uart.h>
#include <zephyr/kernel.h>
#include <zephyr/spinlock.h>
#include <zephyr/sys/iterable_sections.h>
#include <zephyr/usb/usb_device.h>
#include <zephyr/usb/usbd.h>
#include <zephyr/logging/log.h>

LOG_MODULE_REGISTER(usb);

using UsbContext = struct usbd_contex;

namespace {

constexpr uint16_t COPROC_USB_VID(0x16c0);
constexpr uint16_t COPROC_USB_PID(0x27de);
constexpr uint8_t ATTRIBUTES = (IS_ENABLED(CONFIG_SAMPLE_USBD_SELF_POWERED) ?
				   USB_SCD_SELF_POWERED : 0) |
				  (IS_ENABLED(CONFIG_SAMPLE_USBD_REMOTE_WAKEUP) ?
				   USB_SCD_REMOTE_WAKEUP : 0);

RingBuffer<1024> usb_rx_buffer;
UsbContext *usb_serial;
struct k_spinlock usb_event_lock;
K_EVENT_DEFINE(usb_events);

} // anonymous

USBD_DEVICE_DEFINE(usb_serial_dev,
		   DEVICE_DT_GET(DT_NODELABEL(zephyr_udc0)),
		   COPROC_USB_VID, COPROC_USB_PID);
USBD_DESC_LANG_DEFINE(lang_desc);
USBD_DESC_MANUFACTURER_DEFINE(mnfr_desc, "Snostorm Labs");
USBD_DESC_PRODUCT_DEFINE(product_desc, "Megabit coproc");
USBD_DESC_SERIAL_NUMBER_DEFINE(sn_desc, "0123456789ABCDEF");
USBD_CONFIGURATION_DEFINE(usb_cfg, ATTRIBUTES, 125);

static UsbContext * init_usb_device() {
	if (int err = usbd_add_descriptor(&usb_serial_dev, &lang_desc); err) {
		LOG_ERR("Failed to init_leds language descriptor (%d)", err);
		return nullptr;
	}

	if (int err = usbd_add_descriptor(&usb_serial_dev, &mnfr_desc); err) {
		LOG_ERR("Failed to init_leds manufacturer descriptor (%d)", err);
		return nullptr;
	}

	if (int err = usbd_add_descriptor(&usb_serial_dev, &product_desc); err) {
		LOG_ERR("Failed to init_leds product descriptor (%d)", err);
		return nullptr;
	}

	if (int err = usbd_add_descriptor(&usb_serial_dev, &sn_desc); err) {
		LOG_ERR("Failed to init_leds SN descriptor (%d)", err);
		return nullptr;
	}
	
	if (int err = usbd_add_configuration(&usb_serial_dev, &usb_cfg); err) {
		LOG_ERR("Failed to add configuration (%d)", err);
		return nullptr;
	}

    // This macro causes link-time failures for undefined references it generates to
    // _usbd_class_node_list_start and _usbd_class_node_list_end
	STRUCT_SECTION_FOREACH(usbd_class_node, node) {
		// Pull everything that is enabled in our configuration.
		if (int err = usbd_register_class(&usb_serial_dev, node->name, 1); err) {
			LOG_ERR("Failed to register %s (%d)", node->name, err);
			return nullptr;
		}

		LOG_DBG("Register %s", node->name);
	}

    /*
     * Class with multiple interfaces have an Interface
     * Association Descriptor available, use an appropriate triple
     * to indicate it.
     */
    usbd_device_set_code_triple(&usb_serial_dev, USB_BCC_MISCELLANEOUS, 0x02, 0x01);

	if (int err = usbd_init(&usb_serial_dev); err) {
		LOG_ERR("Failed to init_leds device support");
		return nullptr;
	}

	return &usb_serial_dev;
}

namespace {

int enable_usb_device_next() {
    usb_serial = init_usb_device();
    if (usb_serial == nullptr) {
	    LOG_ERR("Failed to init_leds USB device");
	    return -ENODEV;
    }

    if (int err = usbd_enable(usb_serial); err) {
	    LOG_ERR("Failed to enable device support");
	    return err;
    }

    LOG_DBG("USB device support enabled");
    return 0;
}

void usb_interrupt(const struct device * dev, void * /* user_data */) {
	while (uart_irq_update(dev) && uart_irq_is_pending(dev)) {
		if (uart_irq_rx_ready(dev)) {
			// Post a receive event
			k_event_post(&usb_events, 1u << 0);
		}

		if (uart_irq_tx_ready(dev)) {
			// Post a different event
			k_event_post(&usb_events, 1u << 1);
		}
	}
}

} // anonymous

int init_usb_stack(const struct device * dev) {
	if (!device_is_ready(dev)) {
		LOG_ERR("CDC ACM device not ready");
		return -ENODEV;
	}

	if (int ret = enable_usb_device_next(); ret != 0) {
		LOG_ERR("Failed to enable USB");
		return ret;
	}

	LOG_INF("Wait for DTR");

	while (true) {
        u32 dtr = 0;
		uart_line_ctrl_get(dev, UART_LINE_CTRL_DTR, &dtr);
		if (dtr) {
			break;
		} else {
			/* Give CPU resources to low priority threads. */
			k_sleep(K_MSEC(100));
		}
	}

	LOG_INF("DTR set");

	if (int ret = uart_line_ctrl_set(dev, UART_LINE_CTRL_DCD, 1); ret) {
		LOG_WRN("Failed to set DCD, ret code %d", ret);
	}
	if (int ret = uart_line_ctrl_set(dev, UART_LINE_CTRL_DSR, 1); ret) {
		LOG_WRN("Failed to set DSR, ret code %d", ret);
	}

	/* Wait 100ms for the host to do all settings */
	k_msleep(100);

    u32 baudrate = 0;
	if (int ret = uart_line_ctrl_get(dev, UART_LINE_CTRL_BAUD_RATE, &baudrate); ret) {
		LOG_WRN("Failed to get baudrate, ret code %d", ret);
	} else {
		LOG_INF("Baudrate detected: %d", baudrate);
	}

	uart_irq_callback_set(dev, usb_interrupt);
	uart_irq_rx_enable(dev);
	uart_irq_tx_enable(dev);

    return 0;
}

int usb_task_main() {
	const struct device *dev = DEVICE_DT_GET_ONE(zephyr_cdc_acm_uart);
	if (init_usb_stack(dev) != 0) {
		LOG_ERR("Failed to init USB stack");
		while (true) {
			k_msleep(100);
		}
	}

	while (true) {
		auto events = k_event_wait(&usb_events, 0xFFFF, false, K_MSEC(50));
		if (events & (1u << 0)) {
			// Received bytes event
			K_SPINLOCK(&usb_event_lock) {
				std::array<u8, 64> buffer;
				usize len = std::min(usb_rx_buffer.space_in_buffer(), buffer.size());

				if (len == 0) {
					/* Throttle because ring buffer is full */
					// TODO Send message when this occurs
					continue;
				}

				int bytes_rx = uart_fifo_read(dev, buffer.data(), len);
				if (bytes_rx < 0) {
					LOG_ERR("Failed to read UART FIFO");
					bytes_rx = 0;
				};

				int bytes_written = usb_rx_buffer.write(buffer.data(), bytes_rx);
				if (bytes_written < bytes_rx) {
					LOG_ERR("Drop %u bytes", bytes_rx - bytes_written);
				}
			}
			// Now read data from the buffer to decode
		}
		if (events & (1u << 1)) {
			// Transmitted bytes event
		}
	}
}

K_THREAD_DEFINE(usb_thread_id, 1024, usb_task_main, nullptr, nullptr, nullptr, 5, 0, 0);
```

## src/usb.hpp
```c
#pragma once

#include "types.hpp"
#include "zephyr-usbd-wrapper.h"
```

## src/zephyr-usbd-wrapper.h
```c
#pragma once

// This header uses "class" as an identifier in a function signature...

#define class class_
#include <zephyr/usb/usbd.h>
#undef class
```
